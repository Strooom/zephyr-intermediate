## CMakeLists.txt
```
cmake_minimum_required(VERSION 3.20.0)
find_package(Zephyr REQUIRED HINTS $ENV{ZEPHYR_BASE})
project(my_zephyr_app)
target_sources(app PRIVATE src/main.cpp)
```

## west.yml
```
manifest:
  version: 1.0

  projects:
    - name: zephyr
      url: https://github.com/zephyrproject-rtos/zephyr
      revision: v4.4.0
      import:
        name-allowlist:
          - cmsis_6
          - hal_stm32
          - hal_nxp
```

## prj.conf
```kconfig
CONFIG_LOG=y
CONFIG_THREAD_NAME=y
CONFIG_NO_OPTIMIZATIONS=y
CONFIG_TIMESLICING=y
CONFIG_TIMESLICE_SIZE=10
CONFIG_TIMESLICE_PRIORITY=0
CONFIG_ZBUS=y
CONFIG_ASSERT=y
CONFIG_HW_STACK_PROTECTION=y
CONFIG_STACK_SENTINEL=y
CONFIG_MAIN_STACK_SIZE=2048
```

## src/main.cpp
```c
#include <zephyr/kernel.h>
#include <zephyr/logging/log.h>
#include <zephyr/zbus/zbus.h>

LOG_MODULE_REGISTER(demo, LOG_LEVEL_DBG);

struct sensorData {
    uint32_t measurementValue;
    uint32_t timestampInMs;
};

ZBUS_CHAN_DEFINE(mySensorChannel, sensorData, NULL, NULL, ZBUS_OBSERVERS(syncListener, asyncListener), ZBUS_MSG_INIT(.measurementValue = 0, .timestampInMs = 0));

static void onTimerExpiry(struct k_timer *timer)
{
    struct sensorData someData;
    someData.measurementValue = 123;
    someData.timestampInMs = k_uptime_get_32();
    LOG_INF("publish %u, %u", someData.measurementValue, someData.timestampInMs);    
    zbus_chan_pub(&mySensorChannel, &someData, K_NO_WAIT);
}
K_TIMER_DEFINE(theTimer, onTimerExpiry, NULL);


void mySynchronousListener(const struct zbus_channel *someChannel)
{
    const struct sensorData *msg = static_cast<const sensorData *>(zbus_chan_const_msg(someChannel));
    LOG_INF("listenSynchronous %u, %u", msg->measurementValue, msg->timestampInMs);    
}
ZBUS_LISTENER_DEFINE(syncListener, mySynchronousListener);

ZBUS_SUBSCRIBER_DEFINE(asyncListener, 8); 

int main(void)
{
    LOG_INF("Starting timer");
    k_timer_start(&theTimer, K_MSEC(1000), K_MSEC(1000));

    while (true) {
        k_sleep(K_MSEC(2000));

        const struct zbus_channel *someChannel;
        while (!zbus_sub_wait(&asyncListener, &someChannel, K_FOREVER)) 
            {
            struct sensorData msg;
            zbus_chan_read(someChannel, &msg, K_MSEC(100));
            LOG_INF("listenAsynchronous %u, %u", msg.measurementValue, msg.timestampInMs);
        }
    }
    return 0;
}
```
